/ {
    chosen {
        zmk,kscan = &default_kscan;
    };

    main_encoder: main_encoder {
        compatible = "alps,ec11";
        a-gpios = <&pro_micro 14 (GPIO_ACTIVE_HIGH | GPIO_PULL_UP)>;
        b-gpios = <&pro_micro 16 (GPIO_ACTIVE_HIGH | GPIO_PULL_UP)>;
        steps = <80>;
        status = "disabled";
    };

    default_kscan: kscan {
        compatible = "zmk,kscan-gpio-direct";
        wakeup-source;

        input-gpios = <&pro_micro 10 (GPIO_ACTIVE_LOW | GPIO_PULL_UP)>;
    };    
};